## config/west.yml
```yaml
manifest:  
  remotes:  
    - name: zmkfirmware  
      url-base: https://github.com/zmkfirmware  
    - name: na-ka-no
      url-base: https://github.com/na-ka-no
    - name: yamaryu211
      url-base: https://github.com/yamaryu211
  projects:
    - name: zmk-input-processor-temp-layer-threshold
      remote: yamaryu211
      revision: main
  
  projects:  
    - name: zmk
      remote: na-ka-no  # フォークしたリポジトリを参照  
      revision: for-cool642tb_mini  # カスタムブランチ名  
      import: app/west.yml  
    - name: zmk-pmw3610-driver  
      remote: na-ka-no
      revision: main  
```
